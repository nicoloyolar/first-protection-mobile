#include "display.h"

#include <stddef.h>
#include <string.h>

#include "stm32f4xx_hal.h"

#define WIDTH 128
#define PAGES 8
#define RECONFIGURE_MS 5000
#define DEFAULT_CONTRAST 20

/* SPI por software: el SPI1 por hardware usa D13 (LED LD2) o D3 (LED de corte).
 * Todos los pines quedan juntos en el conector derecho de la Nucleo. */
#define CS_PORT GPIOB /* D10 */
#define CS_PIN GPIO_PIN_6
#define RST_PORT GPIOA /* D11 */
#define RST_PIN GPIO_PIN_7
#define A0_PORT GPIOA /* D12: 0 = comando, 1 = datos */
#define A0_PIN GPIO_PIN_6
#define SCK_PORT GPIOB /* D15 */
#define SCK_PIN GPIO_PIN_8
#define SDA_PORT GPIOB /* D14 */
#define SDA_PIN GPIO_PIN_9

/* ~1 MHz de reloj: el modulo tiene resistencias en serie en cada linea
 * (R1-R5) que redondean los flancos, y los cables Dupont suman capacidad. */
#define SPI_HALF_PERIOD_LOOPS 10

/* El ST7567 tiene 132 columnas y el panel usa 128: con las columnas
 * invertidas la imagen queda corrida 4 columnas. */
#define REVERSED_COLUMN_OFFSET 4

static uint8_t framebuffer[PAGES][WIDTH];
static uint8_t contrast = DEFAULT_CONTRAST;
/* Sentido de columnas (eje horizontal) y de filas (eje vertical). Valores
 * de fabrica: los que se leen al derecho en el GM12864-03A del banco. */
static bool columnsReversed = false;
static bool rowsReversed = false;
static uint32_t lastConfigureMs;

/* Fuente 5x7 clasica, ASCII 32..126. Cada byte es una columna, bit 0 arriba. */
static const uint8_t font5x7[][5] = {
    {0x00, 0x00, 0x00, 0x00, 0x00}, {0x00, 0x00, 0x5F, 0x00, 0x00}, {0x00, 0x07, 0x00, 0x07, 0x00},
    {0x14, 0x7F, 0x14, 0x7F, 0x14}, {0x24, 0x2A, 0x7F, 0x2A, 0x12}, {0x23, 0x13, 0x08, 0x64, 0x62},
    {0x36, 0x49, 0x55, 0x22, 0x50}, {0x00, 0x05, 0x03, 0x00, 0x00}, {0x00, 0x1C, 0x22, 0x41, 0x00},
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    {0x00, 0x41, 0x36, 0x08, 0x00}, {0x08, 0x08, 0x2A, 0x1C, 0x08},
};

/* ---- SPI por software (modo 3: SCK en reposo alto, el ST7567 lee SDA en el flanco de subida) ---- */

static inline void pinWrite(GPIO_TypeDef *port, uint16_t pin, bool high)
{
    port->BSRR = high ? pin : (uint32_t)pin << 16;
}

static void spiDelay(void)
{
    for (volatile int i = 0; i < SPI_HALF_PERIOD_LOOPS; i++) {
    }
}

static void spiWriteByte(uint8_t byte)
{
    for (int bit = 7; bit >= 0; bit--) {
        pinWrite(SCK_PORT, SCK_PIN, false);
        pinWrite(SDA_PORT, SDA_PIN, (byte >> bit) & 1);
        spiDelay();
        pinWrite(SCK_PORT, SCK_PIN, true);
        spiDelay();
    }
}

static void writeBytes(bool isData, const uint8_t *bytes, size_t len)
{
    pinWrite(A0_PORT, A0_PIN, isData);
    pinWrite(CS_PORT, CS_PIN, false);
    for (size_t i = 0; i < len; i++) {
        spiWriteByte(bytes[i]);
    }
    pinWrite(CS_PORT, CS_PIN, true);
}

/* Configuracion completa sin reset: se puede reenviar en cualquier momento. */
static void configure(void)
{
    const uint8_t config[] = {
        0xA2,                       /* bias 1/9 */
        columnsReversed ? 0xA1 : 0xA0, /* sentido de las columnas */
        rowsReversed ? 0xC8 : 0xC0,    /* sentido de las filas */
        0x40,                       /* linea de inicio 0 */
        0x25,                       /* razon del regulador interno */
        0x81, contrast,             /* contraste (electronic volume) */
        0x2F,                       /* booster + regulador + seguidor encendidos */
        0xA6,                       /* video normal */
        0xA4,                       /* mostrar la RAM */
        0xAF,                       /* encender */
    };
    writeBytes(false, config, sizeof config);
}

void display_init(void)
{
    GPIO_InitTypeDef gpio = {0};

    __HAL_RCC_GPIOA_CLK_ENABLE();
    __HAL_RCC_GPIOB_CLK_ENABLE();

    pinWrite(CS_PORT, CS_PIN, true);
    pinWrite(SCK_PORT, SCK_PIN, true);

    gpio.Mode = GPIO_MODE_OUTPUT_PP;
    gpio.Pull = GPIO_NOPULL;
    gpio.Speed = GPIO_SPEED_FREQ_LOW;
    gpio.Pin = CS_PIN | SCK_PIN | SDA_PIN;
    HAL_GPIO_Init(GPIOB, &gpio);
    gpio.Pin = RST_PIN | A0_PIN;
    HAL_GPIO_Init(GPIOA, &gpio);

    /* Reset por hardware y luego por software. */
    pinWrite(RST_PORT, RST_PIN, false);
    HAL_Delay(5);
    pinWrite(RST_PORT, RST_PIN, true);
    HAL_Delay(5);
    const uint8_t softReset = 0xE2;
    writeBytes(false, &softReset, 1);
    HAL_Delay(5);

    configure();
    lastConfigureMs = HAL_GetTick();
}

bool display_ready(uint32_t nowMs)
{
    if (nowMs - lastConfigureMs >= RECONFIGURE_MS) {
        lastConfigureMs = nowMs;
        configure();
    }
    return true;
}

void display_set_contrast(uint8_t value)
{
    contrast = value > DISPLAY_CONTRAST_MAX ? DISPLAY_CONTRAST_MAX : value;
    configure();
}

uint8_t display_contrast(void)
{
    return contrast;
}

void display_toggle_flip(void)
{
    columnsReversed = !columnsReversed;
    rowsReversed = !rowsReversed;
    configure();
    display_flush();
}

void display_toggle_mirror(void)
{
    columnsReversed = !columnsReversed;
    configure();
    display_flush();
}

const char *display_orientation(void)
{
    if (!columnsReversed && !rowsReversed) return "de fabrica";
    if (columnsReversed && rowsReversed) return "girada 180";
    return columnsReversed ? "espejada" : "girada 180 y espejada";
}

/* ---- Framebuffer ---- */

void display_clear(void)
{
    memset(framebuffer, 0, sizeof framebuffer);
}

void display_text(uint8_t row, uint8_t col, const char *text, bool inverted)
{
    if (row >= DISPLAY_ROWS) {
        return;
    }
    for (; *text && col < DISPLAY_COLS; text++, col++) {
        char c = *text;
        if (c < 32 || c > 126) {
            c = '?';
        }
        uint8_t *cell = &framebuffer[row][col * 6];
        for (int i = 0; i < 5; i++) {
            cell[i] = inverted ? (uint8_t)~font5x7[c - 32][i] : font5x7[c - 32][i];
        }
        cell[5] = inverted ? 0xFF : 0x00;
    }
}

void display_invert_row(uint8_t row)
{
    if (row >= DISPLAY_ROWS) {
        return;
    }
    for (int x = 0; x < WIDTH; x++) {
        framebuffer[row][x] = (uint8_t)~framebuffer[row][x];
    }
}

void display_flush(void)
{
    uint8_t column = columnsReversed ? REVERSED_COLUMN_OFFSET : 0;
    for (uint8_t page = 0; page < PAGES; page++) {
        const uint8_t setPosition[] = {
            (uint8_t)(0xB0 | page),
            (uint8_t)(0x10 | (column >> 4)),
            (uint8_t)(0x00 | (column & 0x0F)),
        };
        writeBytes(false, setPosition, sizeof setPosition);
        writeBytes(true, framebuffer[page], WIDTH);
    }
}
